## bee/drivers/lpc/Kconfig
```kconfig
# Copyright (c) 2026, Realtek Semiconductor Corporation
# SPDX-License-Identifier: Apache-2.0

config REALTEK_BEE_LPC
	bool "Realtek Bee LPC driver"
	default n
	help
	  This option enables the LPC driver for Realtek Bee.
```

## bee/drivers/spi3w/Kconfig
```kconfig
# Copyright (c) 2026, Realtek Semiconductor Corporation
# SPDX-License-Identifier: Apache-2.0

config REALTEK_BEE_SPI3W
	bool "Realtek Bee SPI3W driver"
	default n
	help
	  This option enables the SPI3W driver for Realtek Bee.
```

## rtl87x3g/Kconfig
```kconfig
# Copyright (c) 2025 Realtek Semiconductor Corp.
# SPDX-License-Identifier: Apache-2.0

rsource "subsys/Kconfig"
rsource "platform/hal_lib/Kconfig"

config REALTEK_LIBS_NANDBOOT
    bool 
    default n
    help
        Compile hal lib code with NANDBOOT support.
```

## rtl87x3g/drivers/Kconfig
```kconfig
# Copyright (c) 2024 Realtek Semiconductor Corp.
# SPDX-License-Identifier: Apache-2.0

menu "realtek bsp driver"
# rsource "rcc/Kconfig"

endmenu

config REALTEK_USING_RTL876X_DRIVER
	bool
	default y
	depends on SOC_SERIES_RTL8752H || SOC_SERIES_RTL87X3G
```

## rtl87x3g/platform/hal_lib/Kconfig
```kconfig
# Copyright (c) 2025 Realtek Semiconductor Corp.
# SPDX-License-Identifier: Apache-2.0

config REALTEK_ZEPHYR_ENABLE
    bool
    default y
```

## rtl87x3g/subsys/Kconfig
```kconfig
# Copyright(c) 2024, Realtek Semiconductor Corporation.

menu "Realtek SDK subsys libs selection"
rsource "*/Kconfig"
endmenu
```

## rtl87x3g/subsys/audio/Kconfig
```kconfig
# Copyright(c) 2024, Realtek Semiconductor Corporation.

menu "Realtek Subsys Audio"
config REALTEK_SUBSYS_AUDIO
    bool "Enable Realtek Audio lib"
    default n
    help
       Realtek audio lib support
endmenu
```

## rtl87x3g/subsys/bluetooth/ble_mgr/Kconfig
```kconfig
# Copyright(c) 2024, Realtek Semiconductor Corporation.

menu "Realtek Subsys Bluetooth LE Manager"
config REALTEK_SUBSYS_BLE_MGR
    bool "Enable Realtek Bluetooth LE Manager lib"
    default n
    help
       Realtek Bluetooth LE manager lib support.
endmenu
```

## rtl87x3g/subsys/bluetooth/bt_host/Kconfig
```kconfig
# Copyright(c) 2024, Realtek Semiconductor Corporation.

choice 
    prompt "Realtek Subsys Upperstack"
    default REALTEK_SUBSYS_UPPERSTACK
    config REALTEK_SUBSYS_UPPERSTACK
        bool "default upperstack lib"
    config REALTEK_SUBSYS_UPPERSTACK_HRP
        bool "HRP upperstack lib"
    help
        Application developers should use default upperstack lib.
        HRP upperstack lib for internal usage 
endchoice
```

## rtl87x3g/subsys/bluetooth/gap_ext/Kconfig
```kconfig
# Copyright(c) 2024, Realtek Semiconductor Corporation.

menu "Realtek Subsys GAP"
    config REALTEK_SUBSYS_GAP
        bool "Enable Realtek GAP lib"
        default y
        help
            Realtek GAP lib support.
endmenu
```

## rtl87x3g/subsys/bluetooth/leaudio/Kconfig
```kconfig
# Copyright(c) 2024, Realtek Semiconductor Corporation.

menu "Realtek Subsys BLE audio"
config REALTEK_SUBSYS_BLE_AUDIO
    bool "Enable Realtek BLE audio lib"
    default n
    help
       Realtek BLE audio lib support.
endmenu
```

## rtl87x3g/subsys/btm/Kconfig
```kconfig
# Copyright(c) 2024, Realtek Semiconductor Corporation.

menu "Realtek Subsys Bluetooth Manager"
config REALTEK_SUBSYS_BTM
    bool "Enable Realtek Bluetooth Manager lib"
    default n
    help
       Realtek btm lib support.
endmenu
```

## rtl87x3g/subsys/console/Kconfig
```kconfig
# Copyright(c) 2024, Realtek Semiconductor Corporation.

menu "Realtek Subsys Console"
config REALTEK_SUBSYS_CONSOLE
    bool "Enable Realtek Console lib"
    default n
    help
       Realtek console lib support.
endmenu
```

## rtl87x3g/subsys/gfps/Kconfig
```kconfig
# Copyright(c) 2024, Realtek Semiconductor Corporation.

menu "Realtek GFPS"
config REALTEK_SUBSYS_GFPS
    bool "Enable Realtek GFPS lib"
    default n
    help
       Realtek GFPS support.
endmenu
```

## rtl87x3g/subsys/lwip/Kconfig
```kconfig
# Copyright(c) 2024, Realtek Semiconductor Corporation.

menu "Realtek LWIP"
config REALTEK_SUBSYS_LWIP
    bool "Enable Realtek LWIP lib"
    default n
    help
       Realtek LWIP support.
endmenu
```

## rtl87x3g/subsys/mac_802154/Kconfig
```kconfig
# Copyright(c) 2024, Realtek Semiconductor Corporation.

menu "Realtek Subsys System Manager"
config REALTEK_SUBSYS_MAC_802154
    bool "Enable Realtek mac 802154"
    default n
    help
       Realtek mac 802154 support.
endmenu
```

## rtl87x3g/subsys/mbedtls/Kconfig
```kconfig
# Copyright(c) 2024, Realtek Semiconductor Corporation.

menu "Realtek Subsys System Manager"
config REALTEK_SUBSYS_MBEDTLS
    bool "Enable Realtek mbedtls lib"
    default n
    help
       Realtek mbedtls lib support.
endmenu
```

## rtl87x3g/subsys/remote/Kconfig
```kconfig
# Copyright(c) 2024, Realtek Semiconductor Corporation.

menu "Realtek Subsys Remote"
config REALTEK_SUBSYS_REMOTE
    bool "Enable Realtek Remote lib"
    default n
    help
       Realtek remote lib support.
endmenu
```

## rtl87x3g/subsys/sysm/Kconfig
```kconfig
# Copyright(c) 2024, Realtek Semiconductor Corporation.

menu "Realtek Subsys System Manager"
config REALTEK_SUBSYS_SYSM
    bool "Enable Realtek System Manager lib"
    default n
    help
       Realtek system manager lib support.
endmenu
```

## rtl87x3g/subsys/usb/Kconfig
```kconfig
# Copyright(c) 2024, Realtek Semiconductor Corporation.

menu "Realtek Subsys System Manager"
config REALTEK_SUBSYS_USB
    bool "Enable Realtek USB lib"
    default n
    help
       Realtek USB lib support.
endmenu
```
