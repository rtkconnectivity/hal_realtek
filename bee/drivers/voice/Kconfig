## bee/drivers/voice/Kconfig
```kconfig
# Copyright (c) 2024 Realtek Semiconductor Corp.
# SPDX-License-Identifier: Apache-2.0

config REALTEK_VOICE
	bool "RealTek voice driver"
	default n

config REALTEK_USING_VOICE_ENCODE_LIB
	bool "RealTek voice encode library"
	default y if REALTEK_VOICE
	help
		This option enables the voice encode library for REALTEK MCU.
```

## bee/drivers/wdt/Kconfig
```kconfig
# Copyright (c) 2024 Realtek Semiconductor Corp.
# SPDX-License-Identifier: Apache-2.0
config REALTEK_BEE_AON_WDT
	bool "REALTEK Bee MCU aon watchdog timer"
	default y
	depends on USE_HAL_REALTEK_BEE_AON_WDT
	
	help
	  This option enables the aon wdt driver for REALTEK bee family of
	  processors.

config REALTEK_BEE_CORE_WDT
	bool "REALTEK Bee MCU core watchdog timer"
	default y
	depends on USE_HAL_REALTEK_BEE_CORE_WDT
	
	help
	  This option enables the core wdt driver for REALTEK bee family of
	  processors.
```

## bee/rtl8752h/Kconfig
```kconfig
config REALTEK_BT_CONTROLLER_STACK_SIZE
	int "RealTek bt lowstack stack size"
	default 3072
	depends on SOC_SERIES_RTL8752H
	help
	  This option set the bt lowstack stack size.
```

## bee/rtl87x2g/Kconfig
```kconfig
# Copyright (c) 2024 Realtek Semiconductor Corp.
# SPDX-License-Identifier: Apache-2.0
config REALTEK_USING_SDK_LIB
	bool "RealTek sdk library"
	help
	  This option enables the sdk library.
```
