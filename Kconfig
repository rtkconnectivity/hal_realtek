## bee/Kconfig
```kconfig
# Copyright (c) 2024 Realtek Semiconductor Corp.
# SPDX-License-Identifier: Apache-2.0

rsource "drivers/Kconfig"
rsource "rtl87x2g/Kconfig"
rsource "rtl8752h/Kconfig"

config REALTEK_BT_CONTROLLER_STACK_SIZE
	int "Realtek bt lowstack stack size"
    range 1536 4096
	default 3072
	help
	  This config set the bt lowstack stack size.

config REALTEK_OSIF_TIMER_MAX_COUNT
	int "Max Number of Realtek osif timer to create"
	range 6 4096
	default 10
	help
	  This config set the max number of osif timer to create.

config REALTEK_OSIF_MAX_TASK_PRIORITY
    int
    default 6
    help
      This config CAN NOT be modified. Realtek osif task's priority is restricted to 0 ~ 6.
```

## bee/drivers/Kconfig
```kconfig
# Copyright (c) 2024 Realtek Semiconductor Corp.
# SPDX-License-Identifier: Apache-2.0

menu "realtek bsp driver"
rsource "adc/Kconfig"
rsource "uart/Kconfig"
rsource "rcc/Kconfig"
rsource "pinmux/Kconfig"
rsource "nvic/Kconfig"
rsource "tim/Kconfig"
rsource "rtc/Kconfig"
rsource "dma/Kconfig"
rsource "gpio/Kconfig"
rsource "i2c/Kconfig"
rsource "keyscan/Kconfig"
rsource "ir/Kconfig"
rsource "i2s/Kconfig"
rsource "codec/Kconfig"
rsource "qdec/Kconfig"
rsource "can/Kconfig"
rsource "spi/Kconfig"
rsource "spi3w/Kconfig"
rsource "sdhc/Kconfig"
rsource "usb/Kconfig"
rsource "wdt/Kconfig"
rsource "bluetooth/Kconfig"
rsource "ppt/Kconfig"
rsource "mac_802154/Kconfig"
rsource "voice/Kconfig"
endmenu

config REALTEK_USING_RTL876X_DRIVER
	bool
	default y
	depends on SOC_SERIES_RTL8752H

if PM_DEVICE
config REALTEK_DRIVER_DLPS_CALLBACK_ON_RAM
	bool "Put driver dlps callback on RAM"
	default n
endif
```

## bee/drivers/adc/Kconfig
```kconfig
# Copyright (c) 2024 Realtek Semiconductor Corp.
# SPDX-License-Identifier: Apache-2.0
config REALTEK_BEE_ADC
	bool "REALTEK Bee MCU adc driver"
	default y
	depends on USE_HAL_REALTEK_BEE_ADC

	select USE_HAL_REALTEK_BEE_RCC
	select USE_HAL_REALTEK_BEE_PINMUX
	select USE_HAL_REALTEK_BEE_NVIC

	help
	  This option enables the adc driver for REALTEK Bee MCU.
```

## bee/drivers/bluetooth/Kconfig
```kconfig
# Copyright (c) 2024 Realtek Semiconductor Corp.
# SPDX-License-Identifier: Apache-2.0
config REALTEK_BEE_BT
	bool "REALTEK Bee MCU bluetooth driver"
	default y

	depends on USE_HAL_REALTEK_BEE_HCI

	help
	  This option enables the bluetooth driver for REALTEK bee family of
	  processors.
```

## bee/drivers/can/Kconfig
```kconfig
# Copyright (c) 2025 Realtek Semiconductor Corp.
# SPDX-License-Identifier: Apache-2.0

config REALTEK_CAN
	bool "REALTEK MCU CAN driver"
	default y
	depends on USE_HAL_REALTEK_CAN

	select USE_HAL_REALTEK_RCC
	select USE_HAL_REALTEK_PINMUX
	select USE_HAL_REALTEK_NVIC

	help
	  This option enables the CAN driver for REALTEK MCU.
```

## bee/drivers/codec/Kconfig
```kconfig
# Copyright (c) 2024 Realtek Semiconductor Corp.
# SPDX-License-Identifier: Apache-2.0

config REALTEK_CODEC
	bool "REALTEK MCU codec driver"
	default y
	depends on USE_HAL_REALTEK_CODEC

	select USE_HAL_REALTEK_RCC
	select USE_HAL_REALTEK_PINMUX
	select USE_HAL_REALTEK_NVIC

	help
	  This option enables the codec driver for REALTEK MCU.
```

## bee/drivers/dma/Kconfig
```kconfig
# Copyright (c) 2024 Realtek Semiconductor Corp.
# SPDX-License-Identifier: Apache-2.0
config REALTEK_BEE_DMA
	bool "REALTEK Bee MCU dma driver"
	default y
	depends on USE_HAL_REALTEK_BEE_DMA

	select USE_HAL_REALTEK_BEE_RCC
	select USE_HAL_REALTEK_BEE_PINMUX
	select USE_HAL_REALTEK_BEE_NVIC

	help
	  This option enables the dma driver for REALTEK Bee MCU.
```

## bee/drivers/gpio/Kconfig
```kconfig
# Copyright (c) 2024 Realtek Semiconductor Corp.
# SPDX-License-Identifier: Apache-2.0

config REALTEK_GPIO
	bool "REALTEK MCU gpio driver"
	default y
	depends on USE_HAL_REALTEK_GPIO

	select USE_HAL_REALTEK_RCC
	select USE_HAL_REALTEK_PINMUX
	select USE_HAL_REALTEK_NVIC

	help
	  This option enables the gpio driver forREALTEK MCU.
```

## bee/drivers/i2c/Kconfig
```kconfig
# Copyright (c) 2024 Realtek Semiconductor Corp.
# SPDX-License-Identifier: Apache-2.0
config REALTEK_BEE_I2C
	bool "REALTEK Bee MCU i2c driver"
	default y
	depends on USE_HAL_REALTEK_BEE_I2C

	select USE_HAL_REALTEK_BEE_RCC
	select USE_HAL_REALTEK_BEE_PINMUX
	select USE_HAL_REALTEK_BEE_NVIC

	help
	  This option enables the i2c driver for REALTEK Bee MCU.
```

## bee/drivers/i2s/Kconfig
```kconfig
# Copyright (c) 2024 Realtek Semiconductor Corp.
# SPDX-License-Identifier: Apache-2.0

config REALTEK_I2S
	bool "REALTEK MCU i2s driver"
	default y
	depends on USE_HAL_REALTEK_I2S

	select USE_HAL_REALTEK_RCC
	select USE_HAL_REALTEK_PINMUX
	select USE_HAL_REALTEK_NVIC

	help
	  This option enables the i2s driver for REALTEK MCU.
```

## bee/drivers/ir/Kconfig
```kconfig
# Copyright (c) 2024 Realtek Semiconductor Corp.
# SPDX-License-Identifier: Apache-2.0

config REALTEK_IR
	bool "REALTEK MCU ir driver"
	default y
	depends on USE_HAL_REALTEK_IR

	select USE_HAL_REALTEK_RCC
	select USE_HAL_REALTEK_PINMUX
	select USE_HAL_REALTEK_NVIC

	help
	  This option enables the ir driver for REALTEK MCU.
```

## bee/drivers/keyscan/Kconfig
```kconfig
# Copyright (c) 2024 Realtek Semiconductor Corp.
# SPDX-License-Identifier: Apache-2.0
config REALTEK_BEE_KEYSCAN
	bool "REALTEK Bee MCU keyscan driver"
	default y
	depends on USE_HAL_REALTEK_BEE_KEYSCAN

	select USE_HAL_REALTEK_BEE_RCC
	select USE_HAL_REALTEK_BEE_PINMUX
	select USE_HAL_REALTEK_BEE_NVIC

	help
	  This option enables the keyscan driver for REALTEK Bee MCU.
```

## bee/drivers/mac_802154/Kconfig
```kconfig
# Copyright (c) 2024 Realtek Semiconductor Corp.
# SPDX-License-Identifier: Apache-2.0
config REALTEK_BEE_MAC_802154
	bool "REALTEK Bee MCU mac 802154 driver"
	default n

	help
	  This option enables the mac 802154 driver for REALTEK Bee MCU.
```

## bee/drivers/nvic/Kconfig
```kconfig
# Copyright (c) 2024 Realtek Semiconductor Corp.
# SPDX-License-Identifier: Apache-2.0
config REALTEK_BEE_NVIC
	bool "REALTEK Bee MCU nvic driver"
	default y
	depends on USE_HAL_REALTEK_BEE_NVIC
	default n

	help
	  This option enables the nvic driver for REALTEK Bee MCU.
```

## bee/drivers/pinmux/Kconfig
```kconfig
# Copyright (c) 2024 Realtek Semiconductor Corp.
# SPDX-License-Identifier: Apache-2.0

config REALTEK_PINMUX
	bool "REALTEK MCU pinmux driver"
	default y
	depends on USE_HAL_REALTEK_PINMUX

	help
	  This option enables the pinmux driver for REALTEK MCU.
```

## bee/drivers/ppt/Kconfig
```kconfig
# Copyright (c) 2024 Realtek Semiconductor Corp.
# SPDX-License-Identifier: Apache-2.0

config REALTEK_PPT
	bool "RealTek MCU ppt driver"
	default n

config REALTEK_USING_PPT_SYNC_MASTER
	bool "RealTek ppt master library"
	default y if REALTEK_PPT
	help
		This option enables the ppt master library for REALTEK MCU.
```

## bee/drivers/qdec/Kconfig
```kconfig
# Copyright (c) 2025 Realtek Semiconductor Corp.
# SPDX-License-Identifier: Apache-2.0

config REALTEK_AON_QDEC
	bool "REALTEK MCU aon qdec driver"
	default y
	depends on USE_HAL_REALTEK_AON_QDEC

	select USE_HAL_REALTEK_RCC
	select USE_HAL_REALTEK_PINMUX
	select USE_HAL_REALTEK_NVIC

	help
	  This option enables the aon qdec driver for REALTEK MCU.

config REALTEK_QDEC
	bool "REALTEK MCU qdec driver"
	default y
	depends on USE_HAL_REALTEK_QDEC

	select USE_HAL_REALTEK_RCC
	select USE_HAL_REALTEK_PINMUX
	select USE_HAL_REALTEK_NVIC

	help
	  This option enables the qdec driver for REALTEK MCU.
```

## bee/drivers/rcc/Kconfig
```kconfig
# Copyright (c) 2024 Realtek Semiconductor Corp.
# SPDX-License-Identifier: Apache-2.0
config REALTEK_BEE_RCC
	bool "REALTEK Bee MCU rcc driver"
	default y
	depends on USE_HAL_REALTEK_BEE_RCC
	default n

	help
	  This option enables the rcc driver for REALTEK Bee MCU.
```

## bee/drivers/rtc/Kconfig
```kconfig
# Copyright (c) 2024 Realtek Semiconductor Corp.
# SPDX-License-Identifier: Apache-2.0

config REALTEK_RTC
	bool "REALTEK MCU rtc driver"
	default y
	depends on USE_HAL_REALTEK_RTC

	select USE_HAL_REALTEK_RCC
	select USE_HAL_REALTEK_PINMUX
	select USE_HAL_REALTEK_NVIC

	help
	  This option enables the rtc driver for REALTEK MCU.
```

## bee/drivers/sdhc/Kconfig
```kconfig
# Copyright (c) 2024 Realtek Semiconductor Corp.
# SPDX-License-Identifier: Apache-2.0

config REALTEK_SDHC
	bool "REALTEK MCU sdhc driver"
	default y
	depends on USE_HAL_REALTEK_SDHC

	select USE_HAL_REALTEK_RCC
	select USE_HAL_REALTEK_PINMUX
	select USE_HAL_REALTEK_NVIC
	select REALTEK_USING_SDK_LIB

	help
	  This option enables the sdhc driver for REALTEK MCU.
```

## bee/drivers/spi/Kconfig
```kconfig
# Copyright (c) 2024 Realtek Semiconductor Corp.
# SPDX-License-Identifier: Apache-2.0
config REALTEK_BEE_SPI
	bool "REALTEK Bee MCU spi driver"
	default y
	depends on USE_HAL_REALTEK_BEE_SPI

	select USE_HAL_REALTEK_BEE_RCC
	select USE_HAL_REALTEK_BEE_PINMUX
	select USE_HAL_REALTEK_BEE_NVIC

	help
	  This option enables the spi driver for REALTEK Bee MCU.
```

## bee/drivers/tim/Kconfig
```kconfig
# Copyright (c) 2024 Realtek Semiconductor Corp.
# SPDX-License-Identifier: Apache-2.0
config REALTEK_BEE_TIM
	bool "REALTEK Bee MCU tim driver"
	default y
	depends on USE_HAL_REALTEK_BEE_TIM

	select USE_HAL_REALTEK_BEE_RCC
	select USE_HAL_REALTEK_BEE_PINMUX
	select USE_HAL_REALTEK_BEE_NVIC

	help
	  This option enables the tim driver for REALTEK Bee MCU.

config REALTEK_BEE_ENHTIM
	bool "REALTEK Bee MCU enhtim driver"
	default y
	depends on USE_HAL_REALTEK_BEE_ENHTIM

	select USE_HAL_REALTEK_BEE_RCC
	select USE_HAL_REALTEK_BEE_PINMUX
	select USE_HAL_REALTEK_BEE_NVIC

	help
	  This option enables the enhtim driver for REALTEK Bee MCU.
```

## bee/drivers/uart/Kconfig
```kconfig
# Copyright (c) 2024 Realtek Semiconductor Corp.
# SPDX-License-Identifier: Apache-2.0
config REALTEK_BEE_UART
	bool "REALTEK Bee MCU uart driver"
	default y
	depends on USE_HAL_REALTEK_BEE_UART

	select USE_HAL_REALTEK_BEE_RCC
	select USE_HAL_REALTEK_BEE_PINMUX
	select USE_HAL_REALTEK_BEE_NVIC

	help
	  This option enables the uart driver for REALTEK Bee MCU.
```

## bee/drivers/usb/Kconfig
```kconfig
# Copyright (c) 2024 Realtek Semiconductor Corp.
# SPDX-License-Identifier: Apache-2.0
config REALTEK_BEE_USB
	bool "REALTEK Bee MCU usb driver"
	default y
	depends on USE_HAL_REALTEK_BEE_USB

config REALTEK_BEE_USING_USB_HAL
	bool "RealTek usb hal library"
	default y if REALTEK_BEE_USB
	help
		This option enables the usb hal library for REALTEK Bee MCU.
```
